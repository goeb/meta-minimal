## conf/layer.conf
```bitbake
# We have a conf and classes directory, add to BBPATH
BBPATH .= ":${LAYERDIR}"

# We have recipes-* directories, add to BBFILES
BBFILES += "${LAYERDIR}/recipes-*/*/*.bb \
            ${LAYERDIR}/recipes-*/*/*.bbappend"

BBFILE_COLLECTIONS += "minimal"
BBFILE_PATTERN_minimal = "^${LAYERDIR}/"
BBFILE_PRIORITY_minimal = "5"
LAYERVERSION_minimal = "4"
LAYERSERIES_COMPAT_minimal = "gatesgarth"
```
